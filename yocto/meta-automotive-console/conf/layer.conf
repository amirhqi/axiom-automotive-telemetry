## yocto/meta-automotive-console/conf/layer.conf
```bitbake
BBPATH .= ":${LAYERDIR}"
BBFILES += "${LAYERDIR}/recipes-*/*/*.bb ${LAYERDIR}/recipes-*/*/*.bbappend"
BBFILE_COLLECTIONS += "automotive-console"
BBFILE_PATTERN_automotive-console = "^${LAYERDIR}/"
BBFILE_PRIORITY_automotive-console = "6"
LAYERDEPENDS_automotive-console = "core qt6-layer"
LAYERSERIES_COMPAT_automotive-console = "scarthgap styhead walnascar"
```
